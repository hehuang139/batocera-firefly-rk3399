// SPDX-License-Identifier: (GPL-2.0+ OR MIT)
#include "rk3399-firefly-batocera-sd.dts"

/* Same original Firefly-RK3399 wiring; eMMC image, conservative HS200 mode. */
&sdhci {
	status = "okay";
	/delete-property/ mmc-hs400-1_8v;
	/delete-property/ mmc-hs400-enhanced-strobe;
	mmc-hs200-1_8v;
	max-frequency = <200000000>;
};

&emmc_phy {
	status = "okay";
};
